## conf/layer.conf
```bitbake
# We have a conf and classes directory, add to BBPATH
BBPATH .= ":${LAYERDIR}"

# We have recipes-* directories, add to BBFILES
BBFILES += "${LAYERDIR}/recipes-*/*/*.bb \
            ${LAYERDIR}/recipes-*/*/*.bbappend"

BBFILE_COLLECTIONS += "meta-venom"
BBFILE_PATTERN_meta-venom = "^${LAYERDIR}/"
BBFILE_PRIORITY_meta-venom = "6"

LAYERDEPENDS_meta-venom = "core"
LAYERSERIES_COMPAT_meta-venom = "gatesgarth honister"
```
